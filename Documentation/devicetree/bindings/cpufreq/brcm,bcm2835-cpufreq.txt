## Documentation/devicetree/bindings/cpufreq/brcm,bcm2835-cpufreq.txt
```
Broadcom BCM2835 CPU frequency control

Required properties:

- compatible : should be "brcm,bcm2835-cpufreq"
- brcm,bcm2835-mbox : mailbox used to talk to the CPU frequency control

Example:

cpufreq {
	compatible = "brcm,bcm2835-cpufreq";
	brcm,bcm2835-mbox = <&mailbox>;
};
```

## Documentation/devicetree/bindings/mailbox/brcm,bcm2835-mbox.txt
```
Broadcom BCM2835 VideoCore mailbox IPC

Required properties:

- compatible : should be "brcm,bcm2835-mbox"
- reg : Specifies base physical address and size of the registers.
- interrupts : the interrupt number. Must be <0 1>, the mailbox interrupt.
- brcm,channel-nums : The mailbox channels in use.
- brcm,channel-names : list of symbolic channel names for mailbox clients to
  use.

The number of channel numbers must match the number of channel names.

Example:

mailbox@0x7e00b800 {
	reg = <0x7e00b880 0x40>;
	interrupts = <0 1>;
	brcm,channel-nums = <0 1 3 8>;
	brcm,channel-names = "power", "fb", "vchiq", "property";
};
```

## Documentation/devicetree/bindings/mmc/brcm,bcm2835-mmc.txt
```
Broadcom BCM2835 Arasan EMMC controller

This file documents differences between the core properties described
by mmc.txt and the properties that represent the BCM2835 controller.

Required properties:
- compatible : Should be "brcm,bcm2835-mmc".
- clocks : The clock feeding the EMMC controller.
- dmas : DMA specifiers for tx and rx dma.
- dma-names: RX and TX  DMA request names.

Example:

mmc: mmc@7e300000 {
		compatible = "brcm,bcm2835-mmc";
		reg = <0x7e300000 0x100>;
		interrupts = <2 30>;
		clocks = <&clk_mmc>;
		dmas = <&dma 5>,
		<&dma 5>;
		dma-names = "tx", "rx";
		status = "disabled";
}
```
